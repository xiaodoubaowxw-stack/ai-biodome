## sdkconfig.defaults
```kconfig
# sdkconfig defaults for ESP-IDF
CONFIG_IDF_TARGET="esp32s3"
CONFIG_FREERTOS_HZ=1000
CONFIG_ESP_TASK_WDT_TIMEOUT_S=30
CONFIG_ESP_DEFAULT_CPU_FREQ_MHZ_240=y
# WebSocket support needs sufficient stack
CONFIG_ESP_MAIN_TASK_STACK_SIZE=8192
# Flash and partition
CONFIG_ESPTOOLPY_FLASHSIZE_4MB=y
# I2C driver
CONFIG_SOC_I2C_SUPPORT_HW_FSM=y
CONFIG_HTTPD_WS_SUPPORT=y
```
